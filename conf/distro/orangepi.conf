## conf/distro/orangepi.conf
```bitbake
DISTRO = "orangepi"

PACKAGE_CLASSES = "package_ipk"

DISTRO_NAME = "lycheepi-opi"

DISTRO_FEATURES_append = " ext2 alsa systemd"

DISTRO_FEATURES_append_orange-pi-zero = " wifi"
DISTRO_FEATURES_append_orange-pi-pc = " x11 wayland opengl"
DISTRO_FEATURES_remove_orange-pi-pc = "directfb "

DISTRO_FEATURES_append_orange-pi-pc-plus = " wifi"

VIRTUAL-RUNTIME_init_manager = "systemd"
DISTRO_FEATURES_BACKFILL_CONSIDERED = "sysvinit"
VIRTUAL-RUNTIME_initscripts = ""

XSERVER = "xserver-xorg \
           xserver-xorg-module-exa \ 
           xf86-video-armsoc \
	   xf86-input-evdev \
           xf86-input-mouse \
           xf86-input-keyboard"

PREFERRED_PROVIDER_virtual/kernel = "linux-opi"
PREFERRED_PROVIDER_u-boot = "u-boot-opi"
PREFERRED_PROVIDER_virtual/bootloader = "u-boot-opi"

UBOOT_LOADADDRESS ?= "0x400080OB00"

PREFERRED_PROVIDER_virtual/libgles1 = "mali-blobs"
PREFERRED_PROVIDER_virtual/libgles2 = "mali-blobs"
PREFERRED_PROVIDER_virtual/libegl = "mali-blobs"
PREFERRED_PROVIDER_virtual/egl = "mali-blobs"

XSERVER += "mali-blobs \ 
		mali-blobs-dev"

MACHINE_ESSENTIAL_EddXTRA_RRECOMMENDS += " \
  mali \
"

DEFAULTTUNE = "cortexa7hf-neon-vfpv4"

PREFERRED_VERSION_linux-opi = "4.17"
```

## conf/layer.conf
```bitbake
# We have a conf and classes directory, add to BBPATH
BBPATH .= ":${LAYERDIR}"

# We have recipes-* directories, add to BBFILES
BBFILES += "${LAYERDIR}/recipes-*/*/*.bb \
	${LAYERDIR}/recipes-*/*/*.bbappend"

BBFILE_COLLECTIONS += "orangepi-sunxi"
BBFILE_PATTERN_orangepi-sunxi = "^${LAYERDIR}/"
BBFILE_PRIORITY_orangepi-sunxi = "10"

LAYERSERIES_COMPAT_orangepi-sunxi = "rocko"
```
